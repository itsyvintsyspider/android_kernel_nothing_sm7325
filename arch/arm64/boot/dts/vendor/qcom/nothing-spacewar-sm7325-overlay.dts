/dts-v1/;
/plugin/;

#include "yupik-qrd.dtsi"
#include "nothing-spacewar-sm7325.dtsi"

/ {
	model = "Nothing Phone (1)";
	compatible = "qcom,yupik-idp", "qcom,yupik", "qcom,qrd";

	/* Production Spacewar uses the Yupik QRD variant. The stock DTBO dump
	 * identifies it with MSM IDs 475/515 and board ID 0x1000B/0 — but that
	 * board-id is identical to yupik-qrd-overlay.dts (the generic Yupik
	 * QRD reference-board overlay, also matched against MSM IDs 475/515),
	 * and both overlays are built for CONFIG_ARCH_YUPIK. Selecting the
	 * board-id's sub-type cell as 1 (instead of the reference board's 0)
	 * keeps this overlay distinct from the generic QRD one, following the
	 * same board-id/sub-type convention used elsewhere in this hierarchy
	 * (e.g. yupik-idp-hsp-overlay.dts uses <34 1> against yupik-idp's
	 * <34 0>). Previously diagnosed: with a colliding board-id, the
	 * Spacewar overlay was never selected at boot.
	 */
	qcom,msm-id = <475 0x10000>, <515 0x10000>;
	qcom,board-id = <0x1000B 1>;
};
